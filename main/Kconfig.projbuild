## main/Kconfig.projbuild
```kconfig
menu "Example Configuration"

    config EXAMPLE_USE_HARDCODED_SETUP_CODE
        bool "Use hard-coded setup code"
        default y
        help
            HomeKit does not recommend having the setup code programmed in the accessory as is.
            Instead, it expects setup info (salt-verifier pair) generated for the given setup code.
            Use this option only for testing purposes. For production, the setup info should be
            used.

    config EXAMPLE_SETUP_CODE
        string "HomeKit Setup Code"
        default "111-22-333"
        depends on EXAMPLE_USE_HARDCODED_SETUP_CODE
        help
            Setup code to be used for HomeKot pairing, if hard-coded setup code is enabled.

    config EXAMPLE_SETUP_ID
        string "HomeKit Setup Id"
        default "ES32"
        depends on EXAMPLE_USE_HARDCODED_SETUP_CODE
        help
            Setup id to be used for HomeKot pairing, if hard-coded setup code is enabled.


    config NTP_SERVER
        string "NTP Server"
        default "pool.ntp.org"
        help
            Hostname of the NTP server used to synchronise the system clock.

    config NTP_TIMEZONE
        string "Timezone (POSIX TZ string)"
        default "UTC0"
        help
            POSIX timezone string, e.g. "UTC0", "GMT0BST,M3.5.0/1,M10.5.0"
            or "AEST-10AEDT,M10.1.0,M4.1.0/3". Applied via setenv("TZ",...).

endmenu

menu "Soil probes (RS485)"

    config PROBE_UART_NUM
        int "UART number"
        range 1 2
        default 2
        help
            UART used for the RS485 / Modbus RTU bus to the soil moisture probes. UART0 is the console.

    config PROBE_UART_TX_GPIO
        int "TX GPIO (to transceiver DI)"
        range 0 33
        default 17
        help
            Must be able to drive an output: GPIO34-39 are input-only on the ESP32.

    config PROBE_UART_RX_GPIO
        int "RX GPIO (from transceiver RO)"
        range 0 39
        default 16
        help
            Any GPIO, including the input-only GPIO34-39.

    config PROBE_UART_DE_GPIO
        int "Driver enable GPIO (transceiver DE and /RE)"
        range 0 33
        default 18
        help
            Driven high while transmitting (UART RTS in RS485 half-duplex mode). Must be able to
            drive an output: GPIO34-39 are input-only on the ESP32.

    config PROBE_BAUD
        int "Baud rate"
        default 9600
        help
            Must match every probe on the bus (probe default 9600, 8N2).

    config PROBE_POLL_INTERVAL_S
        int "Poll interval (seconds)"
        range 1 3600
        default 10

endmenu
```
