## main/Kconfig.projbuild
```kconfig
menu "Example Configuration"

    config EXAMPLE_USE_HARDCODED_SETUP_CODE
        bool "Use hard-coded setup code"
        default y
        help
            HomeKit does not recommend having the setup code programmed in the accessory as is.
            Instead, it expects setup info (salt-verifier pair) generated for the given setup code.
            Use this option only for testing purposes. For production, the setup info should be
            used.

    config EXAMPLE_SETUP_CODE
        string "HomeKit Setup Code"
        default "111-22-333"
        depends on EXAMPLE_USE_HARDCODED_SETUP_CODE
        help
            Setup code to be used for HomeKot pairing, if hard-coded setup code is enabled.

    config EXAMPLE_SETUP_ID
        string "HomeKit Setup Id"
        default "ES32"
        depends on EXAMPLE_USE_HARDCODED_SETUP_CODE
        help
            Setup id to be used for HomeKot pairing, if hard-coded setup code is enabled.


    config NTP_SERVER
        string "NTP Server"
        default "pool.ntp.org"
        help
            Hostname of the NTP server used to synchronise the system clock.

    config NTP_TIMEZONE
        string "Timezone (POSIX TZ string)"
        default "UTC0"
        help
            POSIX timezone string, e.g. "UTC0", "GMT0BST,M3.5.0/1,M10.5.0"
            or "AEST-10AEDT,M10.1.0,M4.1.0/3". Applied via setenv("TZ",...).

endmenu
```
